## config/west.yml
```yaml
manifest:
  remotes:
    # - name: zmkfirmware
    #   url-base: https://github.com/zmkfirmware
    - name: kloir-z
      url-base: https://github.com/kloir-z
    - name: caksoylar
      url-base: https://github.com/caksoylar
  projects:
    - name: zmk
      remote: kloir-z
      revision: main
      import: app/west.yml
    - name: zmk-pmw3610-driver
      remote: kloir-z
      revision: scroll-acceleration-feature
    - name: zmk-rgbled-widget
      remote: caksoylar
      # main は 2026-02 の互換シム削除で古い zmk フォークと非互換になったため、
      # 最後にビルドが通っていた時点のリビジョンに固定
      revision: a3510c9de46de8b42c803286f4978466c6ea3916
  self:
    path: config
```
